## conf/layer.conf
```bitbake
# We have a conf and classes directory, add to BBPATH
BBPATH .= ":${LAYERDIR}"

# We have recipes-* directories, add to BBFILES
BBFILES += "${LAYERDIR}/recipes-*/*/*.bb \
            ${LAYERDIR}/recipes-*/*/*.bbappend"

BBFILE_COLLECTIONS += "meta-rs-stm32mp"
BBFILE_PATTERN_meta-rs-stm32mp = "^${LAYERDIR}/"
BBFILE_PRIORITY_meta-rs-stm32mp = "7"

# Note that the layer name differs from the repo name (meta-st-stm32mp):
LAYERDEPENDS_meta-rs-stm32mp = "stm-st-stm32mp"
LAYERSERIES_COMPAT_meta-rs-stm32mp = "zeus"
```

## conf/machine/stm32mp157c-dk2.conf
```bitbake
#@TYPE: Machine
#@NAME: stm32mp157c-dk2
#@DESCRIPTION: Configuration for STM32MP157C-DK2 board (Trusted boot and SDcard only)
#@NEEDED_BSPLAYERS: layers/meta-openembedded/meta-oe layers/meta-openembedded/meta-python

# Based on meta-st-stm32mp/conf/machine/stm32mp1-disco.conf

include conf/machine/include/st-machine-common-stm32mp.inc

# This causes the correct root partition to be set in the generated /boot/extlinux/extlinux.conf
# (via EXTLINUX_ROOT_SDCARD in st-machine-extlinux-config-stm32mp.inc)
ST_VENDORFS = "0"

# =========================================================================
# Chip architecture
# =========================================================================
DEFAULTTUNE = "cortexa7thf-neon-vfpv4"
include conf/machine/include/tune-cortexa7.inc

# =========================================================================
# boot scheme
# =========================================================================
#BOOTSCHEME_LABELS += "basic"
BOOTSCHEME_LABELS += "trusted"
#BOOTSCHEME_LABELS += "optee"

# =========================================================================
# boot device
# =========================================================================
# Define the boot device supported
#BOOTDEVICE_LABELS += "emmc"
#BOOTDEVICE_LABELS += "nand-4-256"
#BOOTDEVICE_LABELS += "nor-emmc"
#BOOTDEVICE_LABELS += "nor-nand-4-256"
#BOOTDEVICE_LABELS += "nor-sdcard"
BOOTDEVICE_LABELS += "sdcard"

# =========================================================================
# Machine settings
# =========================================================================
# Define list of devicetree per board
#STM32MP_DT_FILES_DK += "stm32mp157a-dk1"
STM32MP_DT_FILES_DK += "stm32mp157c-dk2"
#STM32MP_DT_FILES_ED += "stm32mp157c-ed1"
#STM32MP_DT_FILES_EV += "stm32mp157c-ev1"

# =========================================================================
# Machine features
# =========================================================================
MACHINE_FEATURES += "bluetooth"
MACHINE_FEATURES += "wifi"
MACHINE_FEATURES += "${@'gpu' if d.getVar('ACCEPT_EULA_'+d.getVar('MACHINE')) == '1' else ''}"
# Splashscreen enabled
MACHINE_FEATURES += "splashscreen"

# =========================================================================
# Image
# =========================================================================
# Add ubi FSTYPES to default ones for nand volumes
#IMAGE_FSTYPES += "stmultiubi"

# =========================================================================
# Kernel
# =========================================================================
# For eval board: auto-load goodix module (touchscreen module)
#KERNEL_MODULE_AUTOLOAD = "goodix"

# =========================================================================
# WIC for sdcard raw image
# =========================================================================
WIC_CREATE_EXTRA_ARGS = "--no-fstab-update"
WKS_FILE_DEPENDS ?= " \
    u-boot-stm32mp \
    tf-a-stm32mp \
    st-image-bootfs \
"

# Fixed size of the root fs on the SD card
STM32MP_ROOTFS_FIXED_SIZE ?= "768"


# Specifies the layout of the SD card. Has wks.in extension so it can make use of variables
# (e.g. STM32MP_ROOTFS_FIXED_SIZE)
WKS_FILE = "stm32mp157c-dk2-trusted-sdcard.wks.in"
```
